OUTPUT_ARCH(riscv)
ENTRY(_start)
FIRMWARE_SECTION_ALIGNMENT = 0x1000;

SECTIONS {
    . = @LINK_START_ADDRESS@;

    . = ALIGN(FIRMWARE_SECTION_ALIGNMENT);
    sbi_start = .;
    sbi_link_start = ABSOLUTE(sbi_start);

    .text : ALIGN(FIRMWARE_SECTION_ALIGNMENT) {
        _start = .;
        KEEP(*(.text.entry))
        *(.text .text.*)
    }

    . = ALIGN(FIRMWARE_SECTION_ALIGNMENT);
    sbi_rodata_start = .;

    .rodata : ALIGN(FIRMWARE_SECTION_ALIGNMENT) {
        *(.rodata .rodata.*)
        *(.srodata .srodata.*)
        . = ALIGN(FIRMWARE_SECTION_ALIGNMENT);
    }

    .dynsym : ALIGN(8) {
        *(.dynsym)
    }

    .rela.dyn : ALIGN(8) {
        __rel_dyn_start = .;
        *(.rela*)
        __rel_dyn_end = .;
    }

    . = ALIGN(FIRMWARE_SECTION_ALIGNMENT);
    sbi_rodata_end = .;

    .data : ALIGN(FIRMWARE_SECTION_ALIGNMENT) {
        sbi_data_start = .;
        *(.data .data.*)
        *(.sdata .sdata.*)
        . = ALIGN(FIRMWARE_SECTION_ALIGNMENT);
        sbi_data_end = .;
    }
    sidata = LOADADDR(.data);

    .bss (NOLOAD) : ALIGN(FIRMWARE_SECTION_ALIGNMENT) {
        . = ALIGN(128);
        sbi_boot_stack_start = .;
        BOOT_STACK = .;
        . = . + @STACK_SIZE_PER_HART@;
        sbi_boot_stack_end = .;
        . = ALIGN(FIRMWARE_SECTION_ALIGNMENT);
        sbi_heap_start = .;
        . = . + @HEAP_SIZE@;
        sbi_heap_end = .;
        . = ALIGN(FIRMWARE_SECTION_ALIGNMENT);
        sbi_bss_start = .;
        *(.bss .bss.*)
        *(.sbss .sbss.*)
        sbi_bss_end = .;
    }
    /DISCARD/ : {
        *(.eh_frame)
    }

    . = ALIGN(FIRMWARE_SECTION_ALIGNMENT);

    .fdt : ALIGN(FIRMWARE_SECTION_ALIGNMENT) {
        . = ALIGN(16);
        sbi_fdt_start = .;
        KEEP(*(.fdt))
        sbi_fdt_end = .;
    }
    . = ALIGN(FIRMWARE_SECTION_ALIGNMENT);
    sbi_end = .;

    .payload @PAYLOAD_ADDRESS@ : ALIGN(FIRMWARE_SECTION_ALIGNMENT) {
        . = ALIGN(4);
        sbi_payload_start = .;
        KEEP(*(.payload))
        sbi_payload_end = .;
    }
}
